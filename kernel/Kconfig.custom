## kernel/Kconfig.custom
```kconfig
menu "Custom configs"

config CUSTOM_VERSION
	bool "Use custom kernel version"
	default n
	help
	  This option replaces the kernel version found
	  in Makefile with a custom, user chosen one.

	  If unsure, say N.

config CUSTOM_ZRAMSIZE
	int "Use custom zram disksize"
	depends on ZRAM
	default 4096
	help
	  This option changes the default ZRAM disksize
	  to a custom one.
	  It also defaults to the default size,
	  which is 4096.

endmenu
```
